# apollo4b register map
Vendor: Ambiq Micro; Series: Apollo; File version: 1.0
Ultra-Low power ARM Cortex-M4 MCU from Ambiq Micro
CPU: CM4 r1p0, little endian, MPU, FPU, I-cache, D-cache, VTOR, ITCM, DTCM, 3 interrupt priority bits, 0 interrupts
Registers are 32-bit, read-write, reset 0x0 unless marked. A register's access mark holds for its fields unless they carry their own. Offsets are from the block's base; lines under a group give offsets from that group; [hi:lo] are bit positions; {n}, {i} and the like mark numbered series; 'fields as' and 'values as' point back to an identical list; <NAME> marks a mode.

## Memory map
0x40000000 RSTGEN size 0x8860 — MCU Reset Generator
0x40004000 CLKGEN size 0x110 — Clock Generator
0x40004800 RTC size 0x210 — Real Time Clock
0x40008000 TIMER size 0x3F4 — Counter/Timer
0x40008800 STIMER size 0x110 — Counter/Timer
0x4000C000 VCOMP size 0x210 — Voltage Comparator
0x40010000 GPIO size 0x440 — General Purpose IO
0x40011000 APBDMA size 0x44 — APB DMA Register Interfaces
0x4001C000 UART0 size 0x48 — Serial UART
0x4001D000 UART1 size 0x48
0x4001E000 UART2 size 0x48
0x4001F000 UART3 size 0x48
0x40020000 MCUCTRL size 0x458 — MCU Miscellaneous Control Logic
0x40021000 PWRCTRL size 0x250 — PWR Controller Register Bank
0x40024000 WDT size 0x230 — Watchdog Timer
0x40030000 SECURITY size 0x90 — Security Interfaces
0x40034000 IOSLAVE size 0x220 — I2C/SPI Slave
0x40038000 ADC size 0x294 — Analog Digital Converter Control
0x40050000 IOM0 size 0x38C — IO Peripheral Master
0x40051000 IOM1 size 0x38C
0x40052000 IOM2 size 0x38C
0x40053000 IOM3 size 0x38C
0x40054000 IOM4 size 0x38C
0x40055000 IOM5 size 0x38C
0x40056000 IOM6 size 0x38C
0x40057000 IOM7 size 0x38C
0x40060000 MSPI0 size 0x324 — Multi-bit SPI Master
0x40061000 MSPI1 size 0x324
0x40062000 MSPI2 size 0x324
0x40070000 SDIO size 0x100 — SDIO Control Registers
0x40090000 GPU size 0xFF4 — Graphics Processing Unit
0x400A0000 DC size 0x1C04 — Display Controller
0x400A8000 DSI size 0xA4 — Digital Serial Interface Unit
0x400B0000 USB size 0x202C — USB device register descriptions.
0x400B4000 USBPHY size 0x88 — USBPHY device register descriptions.
0x400C0000 CRYPTO size 0x1F30 — Embedded security and cryptographic services
0x40100000 DSP size 0x26C — DSP Control Interface
0x40201000 PDM0 size 0x254 — PDM Audio
0x40202000 PDM1 size 0x254
0x40203000 PDM2 size 0x254
0x40204000 PDM3 size 0x254
0x40208000 I2S0 size 0x404 — I2S ASRC Master/Slave Module
0x40209000 I2S1 size 0x404
0x40210000 AUDADC size 0x294 — Audio Analog Digital Converter Control
0x48000000 CPU size 0x228 — CM4 Complex Registers (Cache, TCM, DAXI)
0x48001000 FPIO size 0x70 — Fast PIO access

## Interrupts
0 BROWNOUT (MCUCTRL) — BROWNOUT_IRQ
1 WDT — WDT_IRQ
2 RTC — RTC_IRQ
3 VCOMP — VCOMP_IRQ
4 IOSLAVE — IOSLAVE_IRQ
5 IOSLAVEACC (IOSLAVE) — IOSLAVEACC_IRQ
{n+6} IOMSTR{n} (IOM{n}) (n=0..7) — IOMSTR{n}_IRQ
14 TIMER — TIMER_IRQ
15 UART0 — UART0_IRQ
16 UART1 — UART1_IRQ
17 UART2 — UART2_IRQ
18 UART3 — UART3_IRQ
19 ADC — ADC_IRQ
20 MSPI0 — MSPI0_IRQ
21 MSPI1 — MSPI1_IRQ
22 MSPI2 — MSPI2_IRQ
23 CLKGEN — CLKGEN_IRQ
24 CRYPTOSEC (CRYPTO) — CRYPTOSEC_IRQ
26 SDIO — SDIO_IRQ
27 USB0 (USB) — USB0_IRQ
28 GPU — GPU_IRQ
29 DC — DC_IRQ
30 DSI — DSI_IRQ
{n+32} STIMER_CMPR{n} (STIMER) (n=0..7) — STIMER_CMPR{n}_IRQ
40 STIMER_OVF (STIMER) — STIMER_OVF_IRQ
42 AUDADC0 (AUDADC) — AUDADC0_IRQ
44 I2S0 — I2S0_IRQ
45 I2S1 — I2S1_IRQ
48 PDM0 — PDM0_IRQ
49 PDM1 — PDM1_IRQ
50 PDM2 — PDM2_IRQ
51 PDM3 — PDM3_IRQ
56 GPIO0_001F (GPIO) — GPIO0_001F_IRQ
57 GPIO0_203F (GPIO) — GPIO0_203F_IRQ
58 GPIO0_405F (GPIO) — GPIO0_405F_IRQ
59 GPIO0_607F (GPIO) — GPIO0_607F_IRQ
60 GPIO1_001F (GPIO) — GPIO1_001F_IRQ
61 GPIO1_203F (GPIO) — GPIO1_203F_IRQ
62 GPIO1_405F (GPIO) — GPIO1_405F_IRQ
63 GPIO1_607F (GPIO) — GPIO1_607F_IRQ
{n+67} TIMER{n} (TIMER) (n=0..15) — TIMER{n}_IRQ
83 CACHE (CPU) — CACHE_IRQ
84 MAX (CPU) — Not a valid IRQ. The maximum IRQ is this value - 1.

## Licence text in the file
Copyright (c) 2024, Ambiq Micro, Inc. All rights reserved. . Redistribution and use in source and binary forms, with or without modification, are permitted provided that the following conditions are met: . 1. Redistributions of source code must retain the above copyright notice, this list of conditions and the following disclaimer. . 2. Redistributions in binary form must reproduce the above copyright notice, this list of conditions and the following disclaimer in the documentation and/or other materials provided with the distribution. . 3. Neither the name of the copyright holder nor the names of its contributors may be used to endorse or promote products derived from this software without specific prior written permission. . Third party software included in this distribution is subject to the additional license terms as defined in the /docs/licenses directory. . THIS SOFTWARE IS PROVIDED BY THE COPYRIGHT HOLDERS AND CONTRIBUTORS "AS IS" AND ANY EXPRESS OR IMPLIED WARRANTIES, INCLUDING, BUT NOT LIMITED TO, THE. IMPLIED WARRANTIES OF MERCHANTABILITY AND FITNESS FOR A PARTICULAR PURPOSE. ARE DISCLAIMED. IN NO EVENT SHALL THE COPYRIGHT HOLDER OR CONTRIBUTORS BE. LIABLE FOR ANY DIRECT, INDIRECT, INCIDENTAL, SPECIAL, EXEMPLARY, OR. CONSEQUENTIAL DAMAGES (INCLUDING, BUT NOT LIMITED TO, PROCUREMENT OF. SUBSTITUTE GOODS OR SERVICES; LOSS OF USE, DATA, OR PROFITS; OR BUSINESS. INTERRUPTION) HOWEVER CAUSED AND ON ANY THEORY OF LIABILITY, WHETHER IN. CONTRACT, STRICT LIABILITY, OR TORT (INCLUDING NEGLIGENCE OR OTHERWISE). ARISING IN ANY WAY OUT OF THE USE OF THIS SOFTWARE, EVEN IF ADVISED OF THE. POSSIBILITY OF SUCH DAMAGE.

## Notices in the file
Copyright (C) 2012-2014 ARM Limited. All rights reserved.
Purpose: System Viewer Description (SVD) Example (Schema Version 1.1)
This is a description of a none-existent and incomplete device
for demonstration purposes only.
- Neither the name of ARM nor the names of its contributors may be used
ARE DISCLAIMED. IN NO EVENT SHALL COPYRIGHT HOLDERS AND CONTRIBUTORS BE
